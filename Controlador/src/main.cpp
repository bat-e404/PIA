/*
 ---> Importacion de las bibliotecas necesarias <---
*/
#include <Arduino.h>
// Biblioteca para conectar el NodeMCU a Internet
#include <ESP8266WiFi.h>
// Biblioteca que conectar la placa a firabase
#include <Firebase_ESP_Client.h>
// Bibliotecas para el sensor BME280
#include <Wire.h>
#include <Adafruit_Sensor.h>
#include <Adafruit_BME280.h>
// Biblioteca para conseguir la hora
#include <NTPClient.h>
#include <WiFiUdp.h>

// Librerias de display
#include <Wire.h>
#include <Adafruit_GFX.h>
#include <Adafruit_SSD1306.h>

// Generador de Token para proceso de la informacion
#include "addons/TokenHelper.h"
// Carga de RTDB para imprimir la informacion
#include "addons/RTDBHelper.h"

// Credenciales de RED
#define WIFI_SSID "INFINITUMC97B"
#define WIFI_PASSWORD "1167706679"

// Api key
#define API_KEY "AIzaSyAISVjkPr15fnP6RfHTet3Khmc_QDHCATs"

// Definimos el correo de autentificacion 
#define USER_EMAIL "estacionTiempo@fcfm.mx"
#define USER_PASSWORD "123456"

// RTDB
#define DATABASE_URL "https://esp8266-firebase-demo-c58df-default-rtdb.firebaseio.com/"

// Parametros de nuestra pantalla
#define ANCHO_PANTALLA 128
#define ALTO_PANTALLA 64
#define OLED_RESET -1
#define DIRECCION_PANTALLA 0x3C

// Instancia de la pantalla  https://programarfacil.com/blog/arduino-blog/ssd1306-pantalla-oled-con-arduino/
Adafruit_SSD1306 display(ANCHO_PANTALLA, ALTO_PANTALLA, &Wire, OLED_RESET);


// Nuestro Logo, 84x52px
const unsigned char PROGMEM logo[] = {
0x00, 0x00, 0x00, 0x00, 0x00, 0x00, 0x00, 0x00, 0x00, 0x00, 0x00, 0x00, 0x00, 0x00, 0x00, 0x00, 
0x1f, 0x80, 0x00, 0x00, 0x00, 0x00, 0x00, 0x00, 0x00, 0x00, 0x00, 0xff, 0xf0, 0x00, 0x00, 0x00, 
0x00, 0x00, 0x00, 0x00, 0x00, 0x03, 0xff, 0xfc, 0x00, 0x00, 0x00, 0x00, 0x00, 0x00, 0x00, 0x00, 
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0x00, 0x00, 0x00, 0x00, 0x00, 0x00, 0x00, 0x00, 0x00, 0x00, 0x00, 0x00 
};

/*
  *** Definicion de Objetos ***
*/

// Define Firebase objects
FirebaseData fbdo;
// Objeto para autentifiar
FirebaseAuth auth;
// Objetos de la configruacion de los datos
FirebaseConfig config;

// UID del usuario
String uid;

// Guarda la ruta principal de la base de datos
String databasePath;
// Nodos que guarda la informacion del DB
String tempPath = "/temperature";
String humPath = "/humidity";
String presPath = "/pressure";
String timePath = "/timestamp";

// Nodo principal que se actualiza cada ciclo
String parentPath;

FirebaseJson json;

// Definir el NTP Client para optener el tiempo
WiFiUDP ntpUDP;
NTPClient timeClient(ntpUDP, "pool.ntp.org");

// Variables para ahorrar tiempo
int timestamp;

// BME280 sensor
Adafruit_BME280 bme; // I2C
float temperature;
float humidity;
float pressure;

// Timer variables (send new readings every three minutes)
unsigned long sendDataPrevMillis = 0;
unsigned long timerDelay = 20000;

// Initialize BME280
void initBME(){
  if (!bme.begin(0x76)) {
    Serial.println("No se pudo encontrar un sensor BME280 válido, verifique el cableado!");
    while (1);
  }
}

// Initialize WiFi
void initWiFi() {
  WiFi.begin(WIFI_SSID, WIFI_PASSWORD);
  Serial.print("Conectando a Wi-Fi..");
  while (WiFi.status() != WL_CONNECTED) {
    Serial.print('.');
    delay(1000);
  }
  Serial.println(WiFi.localIP());
  Serial.println();
}

// Function that gets current epoch time
unsigned long getTime() {
  timeClient.update();
  unsigned long now = timeClient.getEpochTime();
  return now;
}

void setup(){
  
  Serial.begin(115200);

// Validar si se encuentra nuestra pantalla funcionado
  if(!display.begin(SSD1306_SWITCHCAPVCC, DIRECCION_PANTALLA)){
    Serial.println(F("Fallo en la asignacion de SSD1306"));
  }
    
  // Nuestro logo
  display.clearDisplay();
  display.drawBitmap((display.width() - 84)/2,((display.height()-47)/2)+7,logo,84,47,WHITE);
  display.display();

  // Initialize BME280 sensor
  initBME();
  initWiFi();
  timeClient.begin();

  

  // Asigne la clave api (obligatorio)
  config.api_key = API_KEY;

  // Asigne las credenciales de inicio de sesión del usuario
  auth.user.email = USER_EMAIL;
  auth.user.password = USER_PASSWORD;

  // Asigne la URL de RTDB (obligatorio)
  config.database_url = DATABASE_URL;

  Firebase.reconnectWiFi(true);
  fbdo.setResponseSize(4096);

  // Asigne la función de devolución de llamada para la tarea de generación de tokens de ejecución prolongada 
  config.token_status_callback = tokenStatusCallback; //ver addons/TokenHelper.h

  // Asigne el reintento máximo de generación de tokens
  config.max_token_generation_retry = 5;

  // Inicialice la biblioteca con la autenticación y configuración de Firebase
  Firebase.begin(&config, &auth);

  // Obtener el UID del usuario puede tardar unos segundos
  Serial.println("Obtener UID de usuario");
  while ((auth.token.uid) == "") {
    Serial.print('.');
    delay(1000);
  }
  // Imprimir UID de usuario
  uid = auth.token.uid.c_str();
  Serial.print("UID de usuario:: ");
  Serial.println(uid);

  // Actualizar la ruta de la base de datos
  databasePath = "/UsersData/" + uid + "/readings";
}

void loop(){

  // Enviar nuevas lecturas a la base de datos
  if (Firebase.ready() && (millis() - sendDataPrevMillis > timerDelay || sendDataPrevMillis == 0)){
    sendDataPrevMillis = millis();

    //Obtener marca de tiempo actual
    timestamp = getTime();
    Serial.print ("time: ");
    Serial.println (timestamp);

    parentPath= databasePath + "/" + String(timestamp);

    json.set(tempPath.c_str(), String(bme.readTemperature()));
    json.set(humPath.c_str(), String(bme.readHumidity()));
    json.set(presPath.c_str(), String(bme.readPressure()/100.0F));
    json.set(timePath, String(timestamp));
    Serial.printf("Set json... %s\n", Firebase.RTDB.setJSON(&fbdo, parentPath.c_str(), &json) ? "ok" : fbdo.errorReason().c_str());
  }
}